## Documentation/devicetree/bindings/media/i2c/max9286.txt
```
* Maxim Integrated MAX9286 GMSL Quad 1.5Gbps GMSL Deserializer

Required Properties:
 - compatible: Shall be "maxim,max9286"

The following required properties are defined externally in
Documentation/devicetree/bindings/i2c/i2c-mux.txt:
 - Standard I2C mux properties.
 - I2C child bus nodes.

A maximum of 4 I2C child nodes can be specified on the MAX9286, to
correspond with a maximum of 4 input devices.

The device node must contain one 'port' child node per device input and output
port, in accordance with the video interface bindings defined in
Documentation/devicetree/bindings/media/video-interfaces.txt. The port nodes
are numbered as follows.

      Port        Type
    ----------------------
       0          sink
       1          sink
       2          sink
       3          sink
       4          source

Example:
&i2c4 {
	gmsl-deserializer@0 {
		compatible = "maxim,max9286";
		reg = <0x4c>;
		poc-supply = <&poc_12v>;

		#address-cells = <1>;
		#size-cells = <0>;

		ports {
			#address-cells = <1>;
			#size-cells = <0>;

			port@0 {
				reg = <0>;
				max9286_in0: endpoint {
					remote-endpoint = <&rdacm20_out0>;
				};
			};

			port@4 {
				reg = <4>;
				max9286_out0: endpoint {
					clock-lanes = <0>;
					data-lanes = <1 2 3 4>;
					remote-endpoint = <&csi40_in>;
				};
			};
		};

		i2c@0 {
			#address-cells = <1>;
			#size-cells = <0>;
			reg = <0>;

			camera@51 {
				compatible = MAXIM_CAMERA0;
				reg = <0x51 0x61>;

				port {
					rdacm20_out0: endpoint {
						remote-endpoint = <&max9286_in0>;
					};
				};
			};
		};
	};
};
```

## Documentation/devicetree/bindings/media/i2c/rdacm20.txt
```
* Global IMI RDACM20 GMSL Camera

Required Properties:
 - compatible: shall be "imi,rdacm20"
 - reg: MAX9271 and OV10635 I2C addresses

The camera node shall be connected to an I2C bus interface of
the GMSL deserialiser device of which will receive image data.

The device node shall contain one 'port' child node with an
'endpoint' subnode for its digital output video port,
in accordance with the video interface bindings defined in
Documentation/devicetree/bindings/media/video-interfaces.txt.

Example:

i2c@0 {
	#address-cells = <1>;
	#size-cells = <0>;
	reg = <0>;
		camera@51 {
		compatible = MAXIM_CAMERA0;
		reg = <0x51 0x61>;

		port {
			rdacm20_out0: endpoint {
				remote-endpoint = <&max9286_in0>;
			};
		};
	};
};
```
